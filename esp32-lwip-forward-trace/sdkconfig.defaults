## esp32-lwip-forward-trace/sdkconfig.defaults
```kconfig
CONFIG_LWIP_IPV4=y
CONFIG_LWIP_IP_FORWARD=y

CONFIG_ESP_NETIF_IP_LOST_TIMER_INTERVAL=120
CONFIG_LWIP_DHCP_DOES_ARP_CHECK=y

CONFIG_WIFI_STA_DISCONNECTED_PM_ENABLE=n
CONFIG_ESP_WIFI_SOFTAP_SUPPORT=y
CONFIG_ESP_WIFI_STA_SUPPORT=y
```
